;
; Copyright (c) 2011, Hewlett-Packard Company. All rights reserved.<BR>
; 
; SPDX-License-Identifier: BSD-2-Clause-Patent
; 

;choose hex mode for input
 radix hex

  menu.rp
 (
  add
  toolbar
  (
   separator
   toolitem "Reset Target"              "RS"      "sys.ResetTarget"
   separator
   toolitem "Load EFI DXE Symbols"      "DX"      "do EfiLoadDxe"
   toolitem "Load EFI Runtime Symbols"  "RT"      "do EfiLoadRuntimeDxe"
  )
 )
 
  system.config.debugaccessport 0
  system.config.corebase 0x80001000
  system.attach
  break.sel.program onchip
  
  setup.var %hex.on
  setup.var %decimal.OFF


enddo


